## DADAO-env/arch/dadao/configs/dadao_defconfig
```kconfig
### General setup
CONFIG_LOCALVERSION="-dadao"

### Enable loadable module support
CONFIG_MODULES=n
CONFIG_MODULE_UNLOAD=y

### Boot options
CONFIG_CMDLINE="earlyprintk=ocd,keep ignore_loglevel"

#	Graphics support
CONFIG_FB=y
#	Console display driver support
CONFIG_VGA_CONSOLE=n
CONFIG_FRAMEBUFFER_CONSOLE=y
CONFIG_FONTS=y
CONFIG_FONT_8x8=y
CONFIG_FONT_8x16=y
#	Bootup logo
CONFIG_LOGO=n

### File systems
CONFIG_EXT2_FS=m
CONFIG_EXT3_FS=y
CONFIG_EXT4_FS=y
CONFIG_FUSE_FS=m
#	Pseudo filesystems
CONFIG_PROC_FS=y
CONFIG_SYSFS=y
CONFIG_TMPFS=y
```

## ENV-linux/linux-0504-newfiles/arch/dadao/Kconfig
```kconfig
config DADAO
	def_bool y
	select GENERIC_IOMAP
	select GENERIC_IRQ_SHOW
	select HAVE_RCU_TABLE_FREE
	select HAVE_COPY_THREAD_TLS

config 64BIT
	def_bool y

config MMU
	def_bool y
	select	UACCESS_MEMCPY

config PGTABLE_LEVELS
	int
	default 4

config CPU_LITTLE_ENDIAN
	def_bool y

config GENERIC_HWEIGHT
	def_bool y

config GENERIC_CALIBRATE_DELAY
	def_bool y

menu "Kernel Features"

source "kernel/Kconfig.hz"

endmenu

menu "Boot options"

config CMDLINE
	string "Default kernel command string"
	default ""

endmenu
```
